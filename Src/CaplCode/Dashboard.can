/*@!Encoding:1252*/

variables 
{
  message LightState Light_Message;
  message Engine_ACC En_m;
  message Engine_ON_OFF En_state;
  message Engine_Brake En_brake;
  byte Lights_state=0;
  byte accesltor_state=0;
  byte igintion_state=0;
  msTimer T1;
}

on sysvar sysvar::Lights::HazardLightsSwitch
{
  if (@`Lights::HazardLightsSwitch==1)
  {
    Lights_state |= 0x02; 
    Light_Message.dlc=1;
    Light_Message.byte(0)=Lights_state;
    output(Light_Message);
  }
  else
  {
    Lights_state &= (~(0x02));
    Light_Message.byte(0)=Lights_state;
    output(Light_Message);
  }
}

on sysvar sysvar::Lights::HeadLightSwitch
{
  if (@`Lights::HeadLightSwitch==1)
  {
    Lights_state |= 0x01; 
    Light_Message.dlc=1;
    Light_Message.byte(0)=Lights_state;
    output(Light_Message);
  }
  else
  {
    Lights_state &= (~(0x01));
    Light_Message.byte(0)=Lights_state;
    output(Light_Message);
  }
}

on sysvar sysvar::Lights::RightLightSwitch
{
  if (@`Lights::RightLightSwitch==1)
  {
    Lights_state |= 0x04; 
    Light_Message.dlc=1;
    Light_Message.byte(0)=Lights_state;
    output(Light_Message);
  }
  else
  {
    Lights_state &= (~(0x04));
    Light_Message.byte(0)=Lights_state;
    output(Light_Message);
  }
}

on sysvar sysvar::Lights::LeftLightSwitch
{
  if (@`Lights::LeftLightSwitch==1)
  {
    Lights_state |= 0x08; 
    Light_Message.dlc=1;
    Light_Message.byte(0)=Lights_state;
    output(Light_Message);
  }
  else
  {
    Lights_state &= (~(0x08));
    Light_Message.byte(0)=Lights_state;
    output(Light_Message);
  }
}

on sysvar sysvar::Lights::Wiper_switch
{
  if (@`Lights::Wiper_switch==1)
  {
    Lights_state |= (1<<4); 
    Light_Message.dlc=1;
    Light_Message.byte(0)=Lights_state;
    output(Light_Message);
  }
  else
  {
    Lights_state &= (~(1<<4));
    Light_Message.byte(0)=Lights_state;
    output(Light_Message);
  }
}

on sysvar sysvar::Engine::Ignition
{
  if (@`Engine::Ignition ==1)
  {
    igintion_state=1; 
    En_state.dlc=1;
    En_state.byte(0)=1;
    output(En_state);
  }
  else
  {
    igintion_state=0;  
    En_state.dlc=1;
    En_state.byte(0)=0;
    output(En_state);
  }
}

on sysvar sysvar::Engine::brake_switch
{
  if (@`Engine::brake_switch ==1)
  { 
    En_brake.dlc=1;
    En_brake.byte(0)=1;
    output(En_brake);
  }
  else
  {
    En_brake.dlc=1;
    En_brake.byte(0)=0;
    output(En_brake);
  }
}


on timer T1
{
  if(accesltor_state!=0)
  {
    if(accesltor_state==1)
    {
      if(@`Engine::rpm != 3500)
      {
        @`Engine::rpm++;
        En_m.dlc=2;
        En_m.word(0)=@`Engine::rpm;
        output(En_m);
      }
      else
      {
        //motor gonna burn 
      }
    }
    else
    {
      if(@`Engine::rpm != 0)
      {
        @`Engine::rpm--;
        En_m.dlc=2;
        En_m.word(0)=@`Engine::rpm;
        output(En_m);
      }
      else
      {
        accesltor_state=0;
      }
    }
    setTimer(T1,1);
  }
}


on sysvar sysvar::Engine::acceletor_switch
{
  if(igintion_state==1)
  {
    if (@`Engine::acceletor_switch==1)
    {
      accesltor_state=1;
      setTimer(T1,1);
    }
    else
    {
      if(@`Engine::rpm ==0)
      {
        accesltor_state=0;
      }
      else
      {
        accesltor_state=2;
      }
    }
  }
}

on sysvar sysvar::Engine::brake_switch
{
  if (@`Engine::brake_switch==1)
  {
    accesltor_state=1;
    setTimer(T1,25);
  }
  else
  {
    accesltor_state=0;
  }
}
