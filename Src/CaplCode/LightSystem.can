/*@!Encoding:1252*/
includes
{
  
}
variables
{
  message LightState Light_Message;
  msTimer T1;
  msTimer T2;
  byte FlashState=0;
  byte var;
  byte Wiper_state=0;
}

on timer T1 {
  if(FlashState!=0)
  {
    if(FlashState==1)//Flash
    {
      @`Lights::LightDisplay_R ^= 2;
      @`Lights::LightDisplay_L ^= 1;
    }else if(FlashState==2)//right
    {
      @`Lights::LightDisplay_R ^=2;
    }
    else if(FlashState==3)//left
    {
      @`Lights::LightDisplay_L ^= 1;
    }
    else
    {
      @`Lights::LightDisplay_R ^=6;
      @`Lights::LightDisplay_L ^=5;
    }
    setTimer(T1,500);  
  }
}

on timer T2 {
    if(Wiper_state!=0)
    {
      if(@`Lights::wiper_poisition ==15)
      {
        Wiper_state=2; // to change it's dirction decrment
      }
      if(@`Lights::wiper_poisition ==0)
      {
        Wiper_state=1;  // to change it's dirction increament
      }
      if(Wiper_state==2)
      {
        @`Lights::wiper_poisition--;
      }
      else
      {
        @`Lights::wiper_poisition++;
      }
      setTimer(T2,100);  
    }
}

on message LightState
{ 
  var = this.byte(0);
 
  write("%d",var);
  switch(var)
  {
    case (0x01)://Head
          @`Lights::LightDisplay_R=4;
          @`Lights::LightDisplay_L=4;
      break;
      case 0x02://Flash 
          @`Lights::LightDisplay_R=2;
          @`Lights::LightDisplay_L=1;
           FlashState=1;
          setTimer(T1,500);
      break;
      case 0x04:// Right Flash
          @`Lights::LightDisplay_R=2;
          @`Lights::LightDisplay_L=0;
          FlashState=2;
          setTimer(T1,500);
      break;
      case 0x08:// Left Flash
          @`Lights::LightDisplay_R=0;
          @`Lights::LightDisplay_L=1;
          FlashState=3;
          setTimer(T1,500);
      break;
      case 0x03:// Flash And Head
          @`Lights::LightDisplay_R=6;
          @`Lights::LightDisplay_L=5;
          FlashState=4;
          setTimer(T1,500);
      break;
      case 0x10:// wiper
          Wiper_state=1;
          setTimer(T2,100);
      break;
      case 0x11:// wiper&head
          Wiper_state=1;
          @`Lights::LightDisplay_R=4;
          @`Lights::LightDisplay_L=4;
          setTimer(T2,100);
      break;
      case 0x12:// wiper&hazard
          Wiper_state=1;
          @`Lights::LightDisplay_R=2;
          @`Lights::LightDisplay_L=1;
          FlashState=1;
          setTimer(T1,500);
          setTimer(T2,100);
      break;
      case 0x14:// wiper&right
          Wiper_state=1;
          @`Lights::LightDisplay_R=2;
          @`Lights::LightDisplay_L=0;
          FlashState=2;
          setTimer(T1,500);
          setTimer(T2,100);
      break;
      case 0x18:// wiper&left
          Wiper_state=1;
          @`Lights::LightDisplay_R=0;
          @`Lights::LightDisplay_L=1;
          FlashState=3;
          setTimer(T1,500);
          setTimer(T2,100);
      break;
      case 0x13:// wiper&head&hazard  
          Wiper_state=1;
          @`Lights::LightDisplay_R=6;
          @`Lights::LightDisplay_L=5;
          FlashState=4;
          setTimer(T1,500);
          setTimer(T2,100);
      break;
      default :
          @`Lights::LightDisplay_R=0;
          @`Lights::LightDisplay_L=0;  
          FlashState=0;
          Wiper_state=0;
   }
}
